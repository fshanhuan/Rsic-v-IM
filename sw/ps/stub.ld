/* =============================================================================
 * sw/ps/stub.ld — stage-0 stub 的链接脚本
 * -----------------------------------------------------------------------------
 *   .init  在 0x0000（复位向量，只有一条 j）
 *   .stub  在 0xFC00（IROM 顶部 1 KB，抄镜像不会覆盖到自己）
 * 两个段之间是空洞，objcopy -O binary 会用 0 填满（IROM 其余部分本来就是 0）。
 * ============================================================================= */
MEMORY
{
    irom (rx) : ORIGIN = 0x00000000, LENGTH = 64K
}

SECTIONS
{
    .init 0x0000 :
    {
        KEEP(*(.init))
    } > irom

    .stub 0xFC00 :
    {
        KEEP(*(.stub))
    } > irom

    /DISCARD/ :
    {
        *(.comment)
        *(.note*)
        *(.riscv.attributes)
    }
}
